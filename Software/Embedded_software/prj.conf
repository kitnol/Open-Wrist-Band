## prj.conf
```kconfig
# Configure dependencies for CONFIG_MCUMGR_GRP_IMG  
CONFIG_FLASH=y
CONFIG_IMG_MANAGER=y

# Configure dependencies for CONFIG_IMG_MANAGER  
CONFIG_STREAM_FLASH=y
CONFIG_FLASH_MAP=y

# Configure dependencies for CONFIG_MCUMGR_TRANSPORT_UART 
CONFIG_BASE64=y

#enable floats
CONFIG_FPU=y
CONFIG_CBPRINTF_FP_SUPPORT=y

#IMU sensor
CONFIG_I2C=y
CONFIG_SENSOR=y
CONFIG_LIS2DS12=y

#RCT config
CONFIG_RTC=y
CONFIG_RTC_RV3028=y

#GPIO config
CONFIG_GPIO=y
#FLASH setup

CONFIG_SPI=y
CONFIG_SPI_NOR=y
CONFIG_SPI_NOR_SFDP_RUNTIME=y 

CONFIG_FLASH=y
CONFIG_FLASH_PAGE_LAYOUT=y
CONFIG_FLASH_JESD216_API=y
#CONFIG_SPI_NOR_FLASH_LAYOUT_PAGE_SIZE=4096
# --- NEW: LittleFS Support ---
CONFIG_FILE_SYSTEM=y
CONFIG_FILE_SYSTEM_LITTLEFS=y
CONFIG_FILE_SYSTEM_MKFS=y
# LittleFS needs sufficient heap for its operations and formatting
#CONFIG_HEAP_MEM_POOL_SIZE=32768
CONFIG_SYSTEM_WORKQUEUE_STACK_SIZE=4096
CONFIG_PM_EXTERNAL_FLASH_MCUBOOT_SECONDARY=n
CONFIG_PM_PARTITION_REGION_LITTLEFS_EXTERNAL=y
CONFIG_PM_OVERRIDE_EXTERNAL_DRIVER_CHECK=y
#Do not chagne, THIS IS ON PURPOSE 0
CONFIG_PM_PARTITION_SIZE_LITTLEFS=0x0

# CONFIG_FILE_SYSTEM_INIT_PRIORITY=41
# Optional: Enable FS logging to see mount/format activity
CONFIG_FS_LOG_LEVEL_DBG=n

CONFIG_PM=y
CONFIG_PM_DEVICE=y
CONFIG_PM_DEVICE_RUNTIME=n   # keep off unless you specifically need it
CONFIG_POWEROFF=y

# USB CDC ACM (Virtual COM Port)
CONFIG_USB_DEVICE_STACK=y
CONFIG_USB_CDC_ACM=y
CONFIG_USB_DEVICE_VID=0x2FE3
CONFIG_USB_DEVICE_PID=0x0001
CONFIG_USB_DEVICE_MANUFACTURER="MyCompany"
CONFIG_USB_DEVICE_PRODUCT="nRF52833 Data Transfer"
CONFIG_CRC=y
#autostart usb so printk works
CONFIG_CDC_ACM_SERIAL_INITIALIZE_AT_BOOT=n
CONFIG_BOOT_BANNER=n

CONFIG_THREAD_MONITOR=y

# VBUS API for USB dedtection
CONFIG_NRFX_POWER=y

# Serial / UART for CDC
CONFIG_SERIAL=y
CONFIG_CONSOLE=y
CONFIG_UART_INTERRUPT_DRIVEN=y
CONFIG_UART_LINE_CTRL=y

# Shell functionality
# --- Shell ---
CONFIG_SHELL=y
CONFIG_SHELL_THREAD_PRIORITY=14
CONFIG_SHELL_BACKEND_SERIAL=y      # CDC-ACM UART counts as "serial" backend
CONFIG_SHELL_STACK_SIZE=4096
CONFIG_SHELL_CMD_BUFF_SIZE=128
CONFIG_SHELL_ARGC_MAX=12
CONFIG_SHELL_HISTORY=y
CONFIG_SHELL_HISTORY_BUFFER=512
CONFIG_SHELL_TAB=y
CONFIG_SHELL_TAB_AUTOCOMPLETION=y
CONFIG_SHELL_ECHO_STATUS=y
CONFIG_SHELL_BACKEND_SERIAL=y
CONFIG_UART_CONSOLE=y

# Ring buffer for lossless buffering
CONFIG_RING_BUFFER=y
#CONFIG_USB_DEVICE_STACK_NEXT=y
CONFIG_USBD_CDC_ACM_CLASS=y

# Logging (optional, redirect to RTT to avoid USB conflicts)
CONFIG_LOG=y
CONFIG_LOG_BACKEND_UART=y
CONFIG_SHELL_BACKEND_SERIAL_RX_RING_BUFFER_SIZE=256
CONFIG_SHELL_BACKEND_SERIAL_TX_RING_BUFFER_SIZE=8192

# System
CONFIG_MAIN_STACK_SIZE=4096
CONFIG_HEAP_MEM_POOL_SIZE=16384
CONFIG_SHELL_STACK_SIZE=6144
```

## dts/bindings/sensor/ams,custom-AS7058.yaml
```yaml
description: |
    AMS (Austria Mikro Systeme) AS7058 integrated multi-vital sign monitoring device

compatible: "ams,custom-as7058"

include: [sensor-device.yaml, i2c-device.yaml]
```

## src/main.c
```c
/*
 * Copyright (c) 2012-2014 Wind River Systems, Inc.
 *
 * SPDX-License-Identifier: Apache-2.0
 */

#include <stdio.h>
#include <zephyr/kernel.h>
#include <zephyr/sys/printk.h>
#include <zephyr/drivers/sensor.h>
#include <zephyr/logging/log.h>
#include <zephyr/logging/log_ctrl.h> /* add this for LOG_PANIC */

#include <zephyr/drivers/rtc.h>
#include <zephyr/drivers/i2c.h>
#include <zephyr/drivers/flash.h>
#include <zephyr/drivers/gpio.h>
#include <zephyr/drivers/uart.h>
#include <zephyr/pm/device.h>
#include <zephyr/sys/poweroff.h>

#include <zephyr/sys/util.h>
#include <zephyr/fs/fs.h>
#include <zephyr/fs/littlefs.h>
#include <zephyr/storage/flash_map.h>
#include <zephyr/sys/timeutil.h>

// USB includes
#include <zephyr/usb/usb_device.h>
#include <zephyr/sys/ring_buffer.h>
#include <zephyr/usb/usbd.h>
#include <sample_usbd.h>

// Shell includes
#include <zephyr/shell/shell.h>
#include <zephyr/shell/shell_uart.h>   /* shell_backend_uart_get_ptr() */

#include "as7058_typedefs.h"
#include "as7058_drv.h"
#include "flash_drv.h"
#include "usb_drv.h"

LOG_MODULE_REGISTER(main, LOG_LEVEL_DBG);

/*
 *      DEFINITIONS
 */

// Flags
bool usb_connected = false;
bool usb_initalised = false;
bool shell_initialised = false;
bool flash_mounted = false;
bool rtc_initialised = false;
bool imu_initialised = false;
bool as7058_started = false;
bool measurments_en = true;

// Shell definitions
const struct device *i2c_dev;
const struct device *cdc_dev_usb;

// Flash
#define FLASH_NODE DT_NODE_BY_FIXED_PARTITION_LABEL(DT_N_NODELABEL_is25wp01g)
#define SPI_NODE DT_BUS(DT_PARENT(FLASH_NODE))

// AS7058 setup
#define I2C1_NODE DT_NODELABEL(as7058)
#define LIS2DS12_NODE DT_NODELABEL(lis2ds12)  

// DEVICES initialisation
const struct i2c_dt_spec dev_i2c = I2C_DT_SPEC_GET(I2C1_NODE);
const struct device *dev_rtc = DEVICE_DT_GET_ANY(microcrystal_rv3028);
const struct device *flash_dev = DEVICE_DT_GET_ANY(jedec_spi_nor);
//const struct device *dev_imu = DEVICE_DT_GET_ANY(st_lis2ds12);
const struct i2c_dt_spec imu_i2c = I2C_DT_SPEC_GET(LIS2DS12_NODE);

// Data blocks structure
#define rC_fifo_amount 423

struct readingContainer
{
    time_t time_sec;
    struct as7058_fifo_t data[rC_fifo_amount];
    uint8_t flags;
    uint16_t steps;
}; // 1280 bytes container - multiple of 256

// Time structure
struct rtc_time set_time = {
    .tm_year = 126, /* years since 1900 */
    .tm_mon = 5,    /* 0-indexed, January = 0 */
    .tm_mday = 1,
    .tm_hour = 12,
    .tm_min = 0,
    .tm_sec = 0,
};

/*
 *      Functions
 */

// Function to initialise step counter on IMU
int IMU_step_count_init(void)
{
	uint8_t reg;

	if(i2c_reg_read_byte_dt(&imu_i2c, 0x3F, &reg) < 0) {
		LOG_ERR("Failed to read step counter mode");
		return -1;
	}

	LOG_INF("Current 0x3F register: %x", reg);
	reg |= 0x01; // Set bit 0 to enable step counter mode

	if(i2c_reg_write_byte_dt(&imu_i2c, 0x3F, reg) < 0) {
		LOG_ERR("Failed to set step counter mode");
		return -1;
	}

	// Reset the step counter to 0
	if(i2c_reg_read_byte_dt(&imu_i2c, 0x3A, &reg) < 0) {
		LOG_ERR("Failed to read step counter reset register");
		return -1;
	}

	LOG_INF("Current 0x3A register: %x", reg);
	reg |= 0x80;  // Set bit 7 to reset step counter

	if(i2c_reg_write_byte_dt(&imu_i2c, 0x3A, reg) < 0) {
		LOG_ERR("Failed to reset step counter");
		return -1;
	}

	k_msleep(10); // Wait for the reset to take effect

	if(i2c_reg_read_byte_dt(&imu_i2c, 0x3D, &reg) < 0) {
		LOG_ERR("Failed to read FUNC_CK_GATE register after reset");
		return -1;
	}

	reg &= 0x04; // Clear bit 7 to enable step counter output
	LOG_INF("Current 0x3D register: %x", reg);
	
	reg = reg>>2; // Shift right to get the step counter output value
	if(reg != 0) {
		LOG_ERR("Step counter reset not finished, RST_PEDO bit: %x", reg);
	}

	return 0;
}

// Set up time
int rtc_driver_set_time(const struct device *dev_rtc, const struct rtc_time *timeptr)
{

    int ret = rtc_set_time(dev_rtc, timeptr);
    if (ret < 0)
    {
        LOG_ERR("Failed to set RTC time: %d", ret);
        return ret;
    }
    LOG_INF("Time set successfully");
    return 0;
}

// Get current time
int rtc_driver_get_time(const struct device *dev_rtc)
{
    struct rtc_time now;

    int ret = rtc_get_time(dev_rtc, &now);
    if (ret < 0)
    {
        LOG_ERR("Failed to get RTC time: %d", ret);
        return ret;
    }

    LOG_INF("Current time: %04d-%02d-%02d %02d:%02d:%02d",
            now.tm_year + 1900,
            now.tm_mon + 1, /* back to 1-indexed for display */
            now.tm_mday,
            now.tm_hour,
            now.tm_min,
            now.tm_sec);

    return 0;
}

/*
 *      Threads setup
 */

// Thread for saving measurments from as7058
static const struct gpio_dt_spec as7058_irq = GPIO_DT_SPEC_GET(DT_PATH(zephyr_user), ppg_irq_gpios);
static struct gpio_callback as7058_irq_cb;

// Struct for holding the workqueue
static struct k_work as7058_work;

#define WORK_STACK_SIZE 8192
#define WORK_PRIORITY 5

/* Actual processing — runs in work queue thread, not ISR context */
static void as7058_work_handler(struct k_work *work)
{
    ARG_UNUSED(work);

    int ret;
    uint16_t fifo_data_size = 0;
    static struct readingContainer rC;
    uint8_t step_count_h, step_count_l;

    rtc_get_time(dev_rtc, &set_time);
    rC.time_sec = timeutil_timegm(rtc_time_to_tm(&set_time)); //current time in seconds
	rC.steps = 0; //placeholder for step count, can be updated with actual logic
	rC.flags = 0; //placeholder for any flags, can be updated with actual logic

    ret = as7058_fifo_read_level(&dev_i2c, &fifo_data_size);
    if (ret < 0) {
        LOG_ERR("Failed to read FIFO level: %d", ret);
    } else {
        LOG_INF("FIFO level: %u samples", fifo_data_size);
    }

    for (int i = 0; i < fifo_data_size; i++) {
        ret = as7058_read_fifo_raw(&dev_i2c, (uint8_t *)&rC.data[i]);
        if (ret < 0) {
            LOG_ERR("Failed to read FIFO sample: %d", ret);
        }
    }

    if(i2c_reg_read_byte_dt(&imu_i2c, 0x3B, &step_count_l) < 0) {
		LOG_ERR("Failed to read step_count_l data");
	}
	if (i2c_reg_read_byte_dt(&imu_i2c, 0x3C, &step_count_h) < 0) {
		LOG_ERR("Failed to read step_count_h data");
	}

    rC.steps = (step_count_h << 8) | step_count_l;
	
    lfs_append_file("/lfs/readings.bin", &rC, sizeof(rC));

    /*
    
    TODO: Proper flash init
    
    */
}

static void gpio_isr(const struct device *dev, struct gpio_callback *cb, uint32_t pins)
{
    k_work_submit(&as7058_work);
}

// Shell init thread
struct k_work          shell_toggle_work;
static void shell_toggle_handler(struct k_work *work)
{
    ARG_UNUSED(work);
 
    const struct shell *sh = shell_backend_uart_get_ptr();
 
    if (!shell_initialised) {
        /* ── Enable ── */
        shell_start(sh);
        shell_initialised = true;
        LOG_INF("Shell ENABLED - use 'flash read' command to transmit readings");
    } else {
        /* ── Disable ── */
        shell_stop(sh);
        shell_initialised = false;
        LOG_INF("Shell DISABLED");
    }
}

// Data transmition thread
struct k_work   data_transmit_work;
static void data_transmit_handler(struct k_work *work)
{
    ARG_UNUSED(work);

    printk("Thread started\n");

    if(shell_initialised)
    {
        k_work_submit(&shell_toggle_work);
        k_msleep(100);
    }

    printk("Shell toggled\n");

    if (!host_ready) {
        LOG_WRN("Host not ready, cannot transmit");
        return;
    }

    LOG_INF("Starting data transmission...");

    int ret;
    static struct readingContainer onePack;
	struct fs_file_t file;
	struct fs_dirent entry;
	
	ret = fs_stat("/lfs/readings.bin", &entry);
	if (ret < 0) {
		LOG_ERR("Failed to stat file: %d", ret);
		return;
	}

	fs_file_t_init(&file);
	ret = fs_open(&file, "/lfs/readings.bin", FS_O_READ);
	if (ret < 0) {
		LOG_ERR("Failed to open /lfs/readings.bin: %d", ret);
		return;
	}

	LOG_INF("File opened, size: %zu bytes, %zu records", entry.size, entry.size / sizeof(onePack));

    char payload[1280];
	uint32_t records_sent = 0;
	uint32_t total_records = entry.size / sizeof(onePack);

	for (uint32_t i = 0; i < total_records; i++) {
	    ret = lfs_read_file_partial(&file, &onePack, sizeof(onePack));
		if (ret < 0) {
			LOG_ERR("Failed to read record %u: %d", i, ret);
			break;
		}
		
        memcpy(payload, &onePack, sizeof(payload));
		ret = enqueue_packet((uint8_t *)payload, (uint16_t)sizeof(payload), &cdc_dev_usb);
		if (ret < 0) {
            LOG_ERR("enqueue_packet failed for record %u: %d", i, ret);
			break;
    	}
		
		records_sent++;
        k_sleep(K_MSEC(5));
	}

    LOG_INF("Transmission complete: %u/%u records sent", records_sent, total_records);
    fs_close(&file);

    if(!shell_initialised)
    {
        k_work_submit(&shell_toggle_work);
        k_msleep(100);
    }
}

// System init function
static int system_init(void)
{
    int ret;

    // Step counter initilisation
    const struct device *dev_imu = DEVICE_DT_GET_ANY(st_lis2ds12);
	if (dev_imu == NULL || !device_is_ready(dev_imu)) {
        LOG_ERR("IMU Device not ready");
    }

    if (!device_is_ready(imu_i2c.bus)) {
		LOG_ERR("I2C bus %s is not ready!\n\r",imu_i2c.bus->name);
	}

    if(IMU_step_count_init() < 0) {
		LOG_ERR("Failed to initialize IMU step counter");
	}

    // Attaching work handlers   
    k_work_init(&as7058_work, as7058_work_handler);
    k_work_init(&shell_toggle_work, shell_toggle_handler);

    // Cheking if GPIO for interrupts is ready
    ret = gpio_is_ready_dt(&as7058_irq); 
    if (ret < 0) {
        LOG_ERR("init: GPIO device not ready");
        return -ENODEV;
    }

    // Configuring GPIO
    ret = gpio_pin_configure_dt(&as7058_irq, GPIO_INPUT);
    if (ret < 0) return ret;

    // Attaching interrupt to GPIO
    ret = gpio_pin_interrupt_configure_dt(&as7058_irq, GPIO_INT_EDGE_TO_INACTIVE);
    if (ret < 0) return ret;

    // Initialising callback for interrupt
    gpio_init_callback(&as7058_irq_cb, gpio_isr, BIT(as7058_irq.pin));
    ret = gpio_add_callback(as7058_irq.port, &as7058_irq_cb);
    if (ret < 0) return ret;

    // Checking if i2c node for as7058 intialised
    if (!device_is_ready(dev_i2c.bus)) {
        LOG_ERR("I2C bus not ready");
        return -1;
    }

    // Checking if falsh intialised
    if (!device_is_ready(flash_dev)) {
        LOG_ERR("Flash device not ready");
        return -1;
    }
    // Initialising file system
    uint8_t jedec_id[3];
	if (flash_read_jedec_id(flash_dev, (uint8_t *)jedec_id) < 0) {
		LOG_ERR("Failed to read JEDEC ID\n");
		return -1;
	}
	LOG_INF("Flash JEDEC ID: 0x%02X %02X %02X", jedec_id[0], jedec_id[1], jedec_id[2]);
	uint8_t fs_initialized = 0;
	if (init_fs() < 0) {
		LOG_ERR("Filesystem init failed");
		log_flush();
		return -1;
	}
	else {
		fs_initialized = 1;
	}

    // RTC initialising 
	if (dev_rtc == NULL || !device_is_ready(dev_rtc)) {
		LOG_ERR("RTC Device not ready");
	}

    // Setting time 
    rtc_driver_set_time(dev_rtc, &set_time); 
	int rc = lfs_read_file("/lfs/time.bin", &set_time, sizeof(set_time));
	if	( rc == sizeof(set_time)) {
		rtc_driver_set_time(dev_rtc, &set_time);
	}
	else{
		lfs_write_file("/lfs/time.bin", &set_time, sizeof(set_time));
		LOG_ERR("Failed to read time from file, using default error: %d", rc);
	}

    // Initialising AS7058
    ret = as7058_init(&dev_i2c);
    if (ret < 0) return ret;

    k_msleep(10);

    // Starting measurments
    ret = as7058_start(&dev_i2c);
    if (ret < 0) return ret;

    return 0;
}

// USB interrupt
static void usb_status_cb_2(enum usb_dc_status_code status, const uint8_t *param)
{
    switch (status) {
    case USB_DC_CONNECTED:
        /* Stop AS7058 measurements when USB connects */
        k_work_cancel_delayable(&as7058_work);
        as7058_stop(&dev_i2c);
        as7058_started = false;
        
        /* Enable shell for user interaction */
        if (!shell_initialised) {
            k_work_submit(&shell_toggle_work);
        }
        host_ready = true;
        LOG_INF("USB connected - measurements stopped, shell enabled");
        break;
        
    case USB_DC_DISCONNECTED:
        /* Disable shell and stop any pending operations */
        if (shell_initialised) {
            k_work_submit(&shell_toggle_work);
        }

        /* Resume AS7058 measurements */
        if(measurments_en)
        {
            as7058_start(&dev_i2c);
            as7058_started = true;  
        }
        host_ready = false;
        tx_busy    = false;
        LOG_INF("USB disconnected - shell disabled, measurements resumed");
        break;
        
    case USB_DC_CONFIGURED:
        LOG_INF("USB configured (enumeration complete)");
        break;
        
    case USB_DC_SUSPEND:
        LOG_INF("USB suspended");
        break;
        
    case USB_DC_RESUME:
        LOG_INF("USB resumed");
        break;
        
    default:
        break;
    }
}

static struct k_work_delayable line_ctrl_work;
 
static void line_ctrl_handler(struct k_work *work)
{
    check_line_ctrl(cdc_dev_usb);
    k_work_reschedule(&line_ctrl_work, K_MSEC(100));
}

int main(void)
{
    int ret;
    ret = system_init();
    if(ret<0){
        LOG_ERR("System init failed");
        return ret;
    }
    
    ret = usb_enable(usb_status_cb_2);
    if (ret != 0) {
        LOG_ERR("Failed to enable USB: %d", ret);
        return ret;
    }

     if (!device_is_ready(cdc_dev_usb)) {
        LOG_ERR("CDC-ACM device not ready after USB enable");
        return -ENODEV;
    }

    /* ── Wire up the IRQ handler from usb_drv.c ──────────────────── */
    uart_irq_callback_user_data_set(cdc_dev_usb, cdc_irq_handler, NULL);
    uart_irq_rx_enable(cdc_dev_usb);
 
    /* ── Start line-control polling (DTR detection) ──────────────── */
    k_work_init_delayable(&line_ctrl_work, line_ctrl_handler);
    k_work_reschedule(&line_ctrl_work, K_MSEC(100));

    LOG_INF("System ready - measuring continuously until USB connects");
    k_sleep(K_FOREVER);
    return 0;
}
```

## src/shell.c
```c
#include <zephyr/kernel.h>
#include <zephyr/shell/shell.h>
#include <zephyr/sys/ring_buffer.h>
#include <zephyr/logging/log.h>
#include <zephyr/usb/usb_device.h>
#include <zephyr/drivers/uart.h>
#include <string.h>
#include <stdlib.h>

#include <zephyr/fs/fs.h>
#include <zephyr/fs/littlefs.h>
#include "flash_drv.h"
#include "as7058_typedefs.h"

LOG_MODULE_REGISTER(data_tx, LOG_LEVEL_INF);

#define PACKET_SIZE        1280
#define TX_THREAD_PRIORITY 2
#define TX_STACK_SIZE      4096
#define RING_BUF_SIZE      (PACKET_SIZE * 16)

RING_BUF_DECLARE(tx_ring_buf_2, RING_BUF_SIZE);

static K_THREAD_STACK_DEFINE(tx_stack, TX_STACK_SIZE);
static struct k_thread tx_thread_data;
static K_SEM_DEFINE(tx_sem, 0, 1);

/* CDC ACM UART device — second CDC instance so shell keeps its own port */
static const struct device *cdc_dev;

static volatile uint32_t packets_total;
static volatile uint32_t packets_sent;
static volatile bool      tx_running;

struct readingContainer
{
    time_t time_sec;
    struct as7058_fifo_t data[423];
    uint8_t flags;
    uint16_t steps;
}; // 1280 bytes container - multiple of 256

/* ------------------------------------------------------------------ */
/*  Blocking CDC ACM write — retries until all bytes are sent         */
/* ------------------------------------------------------------------ */
static int cdc_write_all(const struct device *dev,
                         const uint8_t *buf, size_t len)
{
    size_t written = 0;

    while (written < len) {
        /* uart_fifo_fill returns number of bytes actually written */
        int ret = uart_fifo_fill(dev, buf + written, len - written);
        if (ret < 0) {
            return ret;
        }
        written += ret;
        if (written < len) {
            k_yield(); /* Let USB stack flush before retrying */
        }
    }
    return 0;
}

/* ------------------------------------------------------------------ */
/*  TX thread: drains ring buffer over CDC ACM                        */
/* ------------------------------------------------------------------ */
static void tx_thread_entry(void *p1, void *p2, void *p3)
{
    ARG_UNUSED(p1); ARG_UNUSED(p2); ARG_UNUSED(p3);



    uint8_t buf[PACKET_SIZE];

    while (tx_running || !ring_buf_is_empty(&tx_ring_buf_2)) {
        k_sem_take(&tx_sem, K_MSEC(10));

        while (!ring_buf_is_empty(&tx_ring_buf_2)) {
            uint32_t got = ring_buf_get(&tx_ring_buf_2, buf, PACKET_SIZE);
            if (got < PACKET_SIZE) {
                continue;
            }

            int ret = cdc_write_all(cdc_dev, buf, PACKET_SIZE);
            if (ret < 0) {
                LOG_ERR("CDC write failed: %d", ret);
                continue;
            }

            packets_sent++;

            if (packets_sent % 10 == 0 || packets_sent == packets_total) {
                LOG_INF("Sent %u / %u packets", packets_sent, packets_total);
            }
        }
    }

    LOG_INF("TX done: %u packets sent", packets_sent);
}

/* ------------------------------------------------------------------ */
/*  Shell command                                                      */
/* ------------------------------------------------------------------ */
static int cmd_data_tx(const struct shell *sh, size_t argc, char **argv)
{

    if (argc < 2) { shell_error(sh, "Usage: flash info <path>"); return -EINVAL; }

    struct fs_dirent e;
    int rc = fs_stat(argv[1], &e);
    
    if (!device_is_ready(cdc_dev)) {
        shell_error(sh, "CDC ACM device not ready");
        return -ENODEV;
    }

    if (tx_running) {
        shell_error(sh, "TX already running");
        return -EBUSY;
    }

    ring_buf_reset(&tx_ring_buf_2);
    packets_total = e.size/1280;
    packets_sent  = 0;
    tx_running    = true;

    shell_print(sh, "TX start: %u packets x %d bytes = %u bytes",
                packets_total, PACKET_SIZE, packets_total * PACKET_SIZE);

    k_tid_t tid = k_thread_create(
        &tx_thread_data,
        tx_stack,
        K_THREAD_STACK_SIZEOF(tx_stack),
        tx_thread_entry,
        NULL, NULL, NULL,
        TX_THREAD_PRIORITY,
        0,
        K_NO_WAIT
    );

    if (!tid) {
        shell_error(sh, "Failed to create TX thread");
        tx_running = false;
        return -ENOMEM;
    }

    /* Producer: fill ring buffer */
    uint8_t packet[PACKET_SIZE];


    static struct readingContainer onePack;
	struct fs_file_t file;
	struct fs_dirent entry;
	fs_stat(argv[1], &entry);

    fs_file_t_init(&file);
	rc = fs_open(&file,argv[1], FS_O_READ);
	if (rc < 0) {
		LOG_ERR("Failed to open %s: %d", argv[1], rc);
	}

    uint32_t produced = 0;
    while (produced < entry.size/sizeof(onePack)) {

        rc = lfs_read_file_partial(&file, &onePack, sizeof(onePack));
		if (rc < 0) {
			LOG_ERR("Failed to read /lfs/readings.bin: %d", rc);
		}

        memcpy(packet, &onePack, sizeof(packet));

        uint32_t written = ring_buf_put(&tx_ring_buf_2, packet, PACKET_SIZE);
        if (written == PACKET_SIZE) {
            produced++;
            k_sem_give(&tx_sem);
        } else {
            k_yield();
        }
    }

    tx_running = false;
    k_sem_give(&tx_sem);

    k_thread_join(&tx_thread_data, K_FOREVER);

    shell_print(sh, "TX complete: %u packets sent", packets_sent);
    return 0;
}

/* ------------------------------------------------------------------ */
/*  Init: get CDC device handle                                        */
/* ------------------------------------------------------------------ */
static int data_tx_init(void)
{
    /* CDC ACM instance 1 — instance 0 is used by the shell */
    cdc_dev = DEVICE_DT_GET(DT_NODELABEL(cdc_acm_uart1));
    if (!device_is_ready(cdc_dev)) {
        LOG_ERR("CDC ACM UART1 not ready");
        return -ENODEV;
    }

    LOG_INF("data_tx ready on CDC ACM UART1");
    return 0;
}

SYS_INIT(data_tx_init, APPLICATION, CONFIG_APPLICATION_INIT_PRIORITY);

 
/* ------------------------------------------------------------------ */
/*  Helpers                                                           */
/* ------------------------------------------------------------------ */
#define CHUNK_SIZE      4096u           /* bytes per chunk              */


static int file_size(const char *path, size_t *out)
{
    struct fs_dirent e;
    int rc = fs_stat(path, &e);
    if (rc == 0) *out = e.size;
    return rc;
}
 
/* ------------------------------------------------------------------ */
/*  cmd: flash ls                                                      */
/* ------------------------------------------------------------------ */
static int cmd_flash_ls(const struct shell *sh, size_t argc, char **argv)
{
    const char *path = (argc >= 2) ? argv[1] : "/lfs";
    struct fs_dir_t dir;
    struct fs_dirent entry;
    fs_dir_t_init(&dir);
 
    int rc = fs_opendir(&dir, path);
    if (rc < 0) { shell_error(sh, "opendir '%s': %d", path, rc); return rc; }
 
    shell_print(sh, "Contents of %s:", path);
    int n = 0;
    for (;;) {
        rc = fs_readdir(&dir, &entry);
        if (rc < 0 || entry.name[0] == '\0') break;
        if (entry.type == FS_DIR_ENTRY_DIR)
            shell_print(sh, "  [DIR]  %s", entry.name);
        else
            shell_print(sh, "  [FILE] %-32s  %6zu bytes", entry.name, entry.size);
        n++;
    }
    fs_closedir(&dir);
    shell_print(sh, "  (%d entr%s)", n, n == 1 ? "y" : "ies");
    return 0;
}
 
/* ------------------------------------------------------------------ */
/*  cmd: flash info                                                    */
/* ------------------------------------------------------------------ */
static int cmd_flash_info(const struct shell *sh, size_t argc, char **argv)
{
    if (argc < 2) { shell_error(sh, "Usage: flash info <path>"); return -EINVAL; }
    struct fs_dirent e;
    int rc = fs_stat(argv[1], &e);
    if (rc < 0) { shell_error(sh, "stat '%s': %d", argv[1], rc); return rc; }
    shell_print(sh, "Path : %s", argv[1]);
    shell_print(sh, "Type : %s", e.type == FS_DIR_ENTRY_DIR ? "directory" : "file");
    shell_print(sh, "Size : %zu bytes", e.size);
    return 0;
}
 
/* ------------------------------------------------------------------ */
/*  cmd: flash rm                                                      */
/* ------------------------------------------------------------------ */
static int cmd_flash_rm(const struct shell *sh, size_t argc, char **argv)
{
    if (argc < 2) { shell_error(sh, "Usage: flash rm <path>"); return -EINVAL; }
    int rc = fs_unlink(argv[1]);
    if (rc < 0) { shell_error(sh, "unlink '%s': %d", argv[1], rc); return rc; }
    shell_print(sh, "Deleted '%s'", argv[1]);
    return 0;
}
 
/* ------------------------------------------------------------------ */
/*  Registration                                                       */
/* ------------------------------------------------------------------ */
SHELL_CMD_ARG_REGISTER(data_tx, NULL,
    "Send N x 1280 byte packets over USB CDC ACM. Usage: data_tx <num_packets>",
    cmd_data_tx, 2, 0);

SHELL_STATIC_SUBCMD_SET_CREATE(flash_cmds,
    SHELL_CMD_ARG(ls,   NULL,
        "List LittleFS directory\nUsage: flash ls [path]",
        cmd_flash_ls,   1, 1),
    SHELL_CMD_ARG(info, NULL,
        "Show file info\nUsage: flash info <path>",
        cmd_flash_info, 2, 0),
    SHELL_CMD_ARG(dump, NULL,
        "Show file info\nUsage: flash info <path>",
        cmd_data_tx, 2, 0),
    SHELL_CMD_ARG(rm,   NULL,
        "Delete a file\nUsage: flash rm <path>",
        cmd_flash_rm,   2, 0),
    SHELL_SUBCMD_SET_END
);
 
SHELL_CMD_REGISTER(flash, &flash_cmds,
    "LittleFS file commands (ls / info / dump / hex / rm)", NULL);


#include <zephyr/drivers/rtc.h>

extern const struct device *dev_rtc;

/* ------------------------------------------------------------------ */
/*  cmd: rtc set time                                                 */
/* ------------------------------------------------------------------ */
static int cmd_rtc_set(const struct shell *sh, size_t argc, char **argv)
{   
    if (argc < 7) {
        shell_error(sh, "Usage: rtc set <year> <month> <day> <hour> <minute>");
        return -EINVAL;
    }
    struct rtc_time set_time = {
        .tm_year = atoi(argv[1]) - 1900, /* years since 1900 */
        .tm_mon = atoi(argv[2]) - 1,     /* 0-indexed, January = 0 */
        .tm_mday = atoi(argv[3]),
        .tm_hour = atoi(argv[4]),
        .tm_min = atoi(argv[5]),
        .tm_sec = atoi(argv[6]),
    };

    shell_print(sh, "Setting time to: %04d-%02d-%02d %02d:%02d:%02d",
            set_time.tm_year + 1900,
            set_time.tm_mon + 1, /* back to 1-indexed for display */
            set_time.tm_mday,
            set_time.tm_hour,
            set_time.tm_min,
            set_time.tm_sec);

    int ret = rtc_set_time(dev_rtc, &set_time);
    if (ret < 0)
    {
        LOG_ERR("Failed to get RTC time: %d", ret);
        return ret;
    }

    return 0;
}

/* ------------------------------------------------------------------ */
/*  cmd: rtc get time                                                 */
/* ------------------------------------------------------------------ */
static int cmd_rtc_get(const struct shell *sh, size_t argc, char **argv)
{   
    struct rtc_time now;

    int ret = rtc_get_time(dev_rtc, &now);
    if (ret < 0)
    {
        LOG_ERR("Failed to get RTC time: %d", ret);
        return ret;
    }

    shell_print(sh, "Current time: %04d-%02d-%02d %02d:%02d:%02d",
            now.tm_year + 1900,
            now.tm_mon + 1, /* back to 1-indexed for display */
            now.tm_mday,
            now.tm_hour,
            now.tm_min,
            now.tm_sec);

    return 0;
}

/* ------------------------------------------------------------------ */
/*  Registration                                                       */
/* ------------------------------------------------------------------ */

SHELL_STATIC_SUBCMD_SET_CREATE(rtc_cmds,
    SHELL_CMD_ARG(get,   NULL,
        "Print current time on device\n"
        "Usage: rtc get",
        cmd_rtc_get,   1, 1),

    SHELL_CMD_ARG(set, NULL,
        "Set time on device\n"
        "Usage: rtc set <year> <month> <day> <hour> <minute>",
        cmd_rtc_set, 7, 0),

    SHELL_SUBCMD_SET_END
);

SHELL_CMD_REGISTER(rtc, &rtc_cmds,
    "RTC commands (get / set)",
    NULL);

#include "as7058_drv.h"

extern const struct i2c_dt_spec dev_i2c;
extern bool measurments_en;

static int cmd_as7058_start(const struct shell *sh, size_t argc, char **argv)
{   
    int ret = as7058_start(&dev_i2c);

    if(ret<0)
    {
        shell_print(sh, "Failed to start measurments\n");
    }
    else{
        shell_print(sh, "Measurments started\n");
    }

    return 0;
}

static int cmd_as7058_enable(const struct shell *sh, size_t argc, char **argv)
{   
    measurments_en = true;
    shell_print(sh, "Measurments enabeled\n");

    return 0;
}

static int cmd_as7058_disable(const struct shell *sh, size_t argc, char **argv)
{   
    measurments_en = false;
    shell_print(sh, "Measurments enabeled\n");

    return 0;
}

static int cmd_as7058_stop(const struct shell *sh, size_t argc, char **argv)
{   
    int ret = as7058_stop(&dev_i2c);

    if(ret<0)
    {
        shell_print(sh, "Failed to start measurments\n");
    }
    else{
        shell_print(sh, "Measurments stopeped\n");
    }

    return 0;
}

static int cmd_as7058_read(const struct shell *sh, size_t argc, char **argv)
{   
    uint16_t fifo_data_size;

    struct as7058_fifo_t data[511];

    int ret = as7058_fifo_read_level(&dev_i2c, &fifo_data_size);
    if (ret < 0) {
        LOG_ERR("Failed to read FIFO level: %d", ret);
    } else {
        LOG_INF("FIFO level: %u samples", fifo_data_size);
    }

    for (int i = 0; i < fifo_data_size; i++) {
        ret = as7058_read_fifo_raw(&dev_i2c, (uint8_t *)&data[i]);
        if (ret < 0) {
            LOG_ERR("Failed to read FIFO sample: %d", ret);
        }
    }

    shell_print(sh, "Printing read FIFO:\n");
    for(int i = 0; i<fifo_data_size; i++)
    {
        shell_print(sh, "%d", ((data[i].fifoh<<16)|(data[i].fifom<<8)|data[i].fifol));
    }

    return 0;
}


/* ------------------------------------------------------------------ */
/*  Registration                                                       */
/* ------------------------------------------------------------------ */

SHELL_STATIC_SUBCMD_SET_CREATE(as7058_cmds,
    SHELL_CMD_ARG(start,   NULL,
        "Start AS7058 measurments\n"
        "Usage: as7058 start",
        cmd_as7058_start,   1, 1),

    SHELL_CMD_ARG(stop, NULL,
        "Stop AS7058 measurments\n"
        "Usage: as7058 stop",
        cmd_as7058_stop, 1,1),

    SHELL_CMD_ARG(read, NULL,
        "Read AS7058 FIFO\n"
        "Usage: as7058 read",
        cmd_as7058_read, 1, 1),

    SHELL_CMD_ARG(enable, NULL,
        "Enabling AS7058 measurments\n"
        "Usage: as7058 enable",
        cmd_as7058_enable, 1, 1),

    SHELL_CMD_ARG(disable, NULL,
        "Disabling AS7058 measurments\n"
        "Usage: as7058 disable",
        cmd_as7058_disable, 1, 1),
    SHELL_SUBCMD_SET_END
);

SHELL_CMD_REGISTER(as7058, &as7058_cmds,
    "RTC commands (get / set)",
    NULL);
```

## src/usb_drv.h
```c
#include <zephyr/usb/usbd.h>   /* struct usbd_context, struct usbd_msg */
#include <zephyr/kernel.h>     /* struct k_work */
#include <zephyr/usb/usb_device.h>
#include <zephyr/sys/ring_buffer.h>
#include <zephyr/usb/usb_device.h>
#include <zephyr/sys/ring_buffer.h>

/* ── Configuration ─────────────────────────────────────────── */
#define TX_RING_BUF_SIZE   4096   /* TX ring buffer (bytes)     */
#define RX_RING_BUF_SIZE   4096   /* RX ring buffer (bytes)     */
#define PACKET_SYNC        0xAA   /* Framing sync byte          */
#define MAX_PAYLOAD        1280   /* Max payload per packet     */
#define SEND_INTERVAL_MS   10     /* How often to send data     */


extern volatile bool host_ready;   /* DTR set by host    */
extern volatile bool tx_busy;      /* TX in progress     */

uint16_t crc16_ccitt_drv(const uint8_t *data, size_t len);

int build_packet(const uint8_t *payload, uint16_t len, uint8_t *out, size_t out_size);

void tx_kick(const struct device *cdc_dev);

void cdc_irq_handler(const struct device *dev, void *user_data);

void check_line_ctrl(const struct device *cdc_dev);

int enqueue_packet(const uint8_t *payload, uint16_t len, const struct device *cdc_dev);

void process_rx(const struct device *cdc_dev);

void usb_status_cb(enum usb_dc_status_code status, const uint8_t *param);

int recv_packet(uint8_t *out, size_t out_max, k_timeout_t timeout);
```
